## CMakeLists.txt
```
cmake_minimum_required(VERSION 3.20.0)

find_package(Zephyr REQUIRED HINTS $ENV{ZEPHYR_BASE})
project(uart_test LANGUAGES CXX C)

include_directories(${CMAKE_CURRENT_SOURCE_DIR}/mock_hw/include)
include_directories(${CMAKE_CURRENT_SOURCE_DIR}/../../../src/threads/include)

target_sources(
  app
  PRIVATE "${CMAKE_CURRENT_SOURCE_DIR}/src/main.c"
          "${CMAKE_CURRENT_SOURCE_DIR}/mock_kernel/uart.c"
          "${CMAKE_CURRENT_SOURCE_DIR}/../../../src/threads/uart.cpp"
)
```

## prj.conf
```kconfig
# Memory
CONFIG_HEAP_MEM_POOL_SIZE=2048
CONFIG_MAIN_STACK_SIZE=2048

CONFIG_PIPES=y

# Workqueue
CONFIG_SYSTEM_WORKQUEUE_STACK_SIZE=2048

# Threads
CONFIG_MAIN_THREAD_PRIORITY=5

# # Enable the UART driver
CONFIG_SERIAL=y
CONFIG_UART_NATIVE_POSIX=y
# CONFIG_NATIVE_UART_0_ON_STDINOUT=y

# For testing
CONFIG_ZTEST=y
CONFIG_ZTEST_NEW_API=y

# C++
CONFIG_CPP=y
# zephyr uses C++11 by default, update to C++20 (most recent supported in v3.4.99)
# See options at zephyr/lib/cpp/Kconfig
CONFIG_STD_CPP20=y
# Enable the C++ standard library
CONFIG_GLIBCXX_LIBCPP=y
```

## src/main.c
```c
#include "uart.h"

#include <zephyr/kernel.h>
#include <zephyr/ztest.h>

extern struct k_fifo uart_rx_fifo;
extern struct k_pipe uart_nus_pipe; 

/**
 * @brief Tests the uart thread.
 *
 * This test checks if the uart thread puts data into the pipe correctly.
 */
ZTEST(uart_thread, test_uart_pipe)
{
  struct uart_data_t *buf_out;
  struct uart_data_t *buf_in;

  // Allocate memory for buffers
  buf_out = k_malloc(sizeof(struct uart_data_t));
  buf_in = k_malloc(sizeof(struct uart_data_t));

  for (int i = 0; i < UART_BUF_SIZE; ++i) {
    // Put data into FIFO buffer
    buf_out->data[i] = i;
    buf_out->len = i + 1;
    k_fifo_put(&uart_rx_fifo, buf_out);

    // Get data from pipe buffer
    size_t bytes_read;
    zassert_true(0 == k_pipe_get(&uart_nus_pipe, buf_in->data, i + 1, &bytes_read, 0, K_FOREVER));

    // Check if data read from pipe buffer matches data put into FIFO buffer
    zassert_true(bytes_read == i + 1);
    zassert_true(buf_in->data[i] == buf_out->data[i]);
    zassert_true(buf_in->len == buf_out->len);
  }
}

ZTEST_SUITE(uart_thread, NULL, NULL, NULL, NULL, NULL);
```
