## CMakeLists.txt
```
cmake_minimum_required(VERSION 3.20.0)

find_package(Zephyr REQUIRED HINTS $ENV{ZEPHYR_BASE})

project(app LANGUAGES CXX)

FILE(GLOB app_sources 
    src/*.cpp
    src/threads/*.cpp
    src/hw/*.cpp
    src/hw/ble/*.cpp
)

target_sources(app PRIVATE ${app_sources})
target_include_directories(app PRIVATE include)
target_include_directories(app PRIVATE src/threads/include)
target_include_directories(app PRIVATE src/hw/include)
target_include_directories(app PRIVATE src/hw/ble/include)
```

## Kconfig
```
# @file Kconfig
# @brief Kconfig file for the application.
#
# This file is the application Kconfig entry point. All application Kconfig
# options can be defined here or included via other application Kconfig files.
# You can browse these options using the west targets menuconfig (terminal) or
# guiconfig (GUI).

menu "Zephyr"
source "Kconfig.zephyr"
endmenu

module = APP
module-str = APP
source "subsys/logging/Kconfig.template.log_config"
```

## prj.conf
```kconfig
# Memory
CONFIG_HEAP_MEM_POOL_SIZE=2048
CONFIG_MAIN_STACK_SIZE=2048
CONFIG_PIPES=y

# Workqueue
CONFIG_SYSTEM_WORKQUEUE_STACK_SIZE=2048

# Threads
CONFIG_MAIN_THREAD_PRIORITY=5

# GPIO
CONFIG_GPIO=y

# Enable the UART driver
CONFIG_UART_ASYNC_API=y
CONFIG_NRFX_UARTE0=y
CONFIG_SERIAL=y
CONFIG_CONSOLE=y
CONFIG_UART_CONSOLE=n

# Enable the BLE stack with device as peripheral
CONFIG_BT=y
CONFIG_BT_PERIPHERAL=y
CONFIG_BT_DEVICE_NAME="my_ble_device"
CONFIG_BT_DEVICE_APPEARANCE=833
CONFIG_BT_MAX_CONN=1
CONFIG_BT_MAX_PAIRED=1

# \todo: We should investigate the need for CONFIG_BT_SMP. Explanation:
#        Not used in peripheral_uart sample app but appears to be needed otherwise get compiler errors
#        undefined reference to `bt_conn_auth_cb_register' and `bt_conn_auth_info_cb_register'.
#        This option enables support for the Security Manager Protocol (SMP), making it possible 
#        to pair devices over BLE. Seems like we need it but not sure why it's not in sample app
CONFIG_BT_SMP=y

# Enable the BLE modules from NCS
CONFIG_BT_NUS=y

# Enable bonding
CONFIG_BT_SETTINGS=y
CONFIG_FLASH=y
CONFIG_FLASH_PAGE_LAYOUT=y
CONFIG_FLASH_MAP=y
CONFIG_NVS=y
CONFIG_SETTINGS=y

# Config logger
CONFIG_LOG=y
CONFIG_RTT_CONSOLE=y
CONFIG_USE_SEGGER_RTT=y
CONFIG_LOG_BACKEND_RTT=y
CONFIG_LOG_BACKEND_UART=n
CONFIG_LOG_PRINTK=n
CONFIG_LOG_MODE_MINIMAL=y

CONFIG_ASSERT=y

# C++ support
CONFIG_CPP=y
# zephyr uses C++11 by default, update to C++20 (most recent supported in v3.4.99)
# See options at zephyr/lib/cpp/Kconfig
CONFIG_STD_CPP20=y
# Enable the C++ standard library
CONFIG_GLIBCXX_LIBCPP=y
```

## src/main.cpp
```c
#include "uart.hpp"
#include <stdint.h>
#include <zephyr/kernel.h>
#include <zephyr/logging/log.h>

LOG_MODULE_DECLARE(app_main);

/**
 * @brief Semaphore used to signal that BLE is initialized.
*/
K_SEM_DEFINE(ble_init_done, 0, 1);

int main(void) {
  LOG_INF("[main thread] begin");
  k_sleep(K_SECONDS(3));

  uint64_t counter = 0;

  while (true) {
    LOG_INF("[main thread] counter: %llu", ++counter);
    k_sleep(K_SECONDS(2));
  }

  return 0;
}
```
