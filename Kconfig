## Kconfig
```kconfig
# @file Kconfig
# @brief Top-level Kconfig file for the Zephyr module.
#
# This Kconfig file is picked by the Zephyr build system because it is defined
# as the module Kconfig entry point (see zephyr/module.yml). You can browse
# module options by going to Zephyr -> Modules in Kconfig.

rsource "drivers/Kconfig"
```

## app/tests/threads/uart/testcase.yaml
```yaml
tests:
  system_controller.uart.test_uart_pipe:
    build_only: true # \todo: remove when tests are ready
    platform_allow: native_posix_64
    integration_platforms:
      # HW agnostic test platform
      # See https://docs.zephyrproject.org/latest/boards/posix/native_posix/doc/index.html
      - native_posix_64
    tags: system_controller_test_uart_pipe
```

## boards/arm/my_custom_board/Kconfig.board
```kconfig
# Define the custom board

config BOARD_MY_CUSTOM_BOARD
	bool "my_custom_board"
	depends on SOC_NRF52832_QFAA
```

## boards/arm/my_custom_board/Kconfig.defconfig
```kconfig
if BOARD_MY_CUSTOM_BOARD

config BOARD
  default "my_custom_board"

config BT_CTLR
  default BT

endif # BOARD_MY_CUSTOM_BOARD
```

## boards/arm/my_custom_board/my_custom_board_defconfig
```kconfig
# board
CONFIG_SOC_SERIES_NRF52X=y
CONFIG_SOC_NRF52832_QFAA=y
CONFIG_BOARD_MY_CUSTOM_BOARD=y

# Enable MPU
CONFIG_ARM_MPU=y

# Enable hardware stack protection
CONFIG_HW_STACK_PROTECTION=y

# Enable RTT
CONFIG_USE_SEGGER_RTT=y

# enable uart driver
CONFIG_SERIAL=y

# enable console
CONFIG_CONSOLE=y
CONFIG_UART_CONSOLE=y

# gpio
CONFIG_GPIO=y
CONFIG_GPIO_AS_PINRESET=y
CONFIG_PINCTRL=y
```
